// Make sure this file is included before all other files





#ifdef HAS_CAPSLOCK
    &caps_word_capslock {
        disable-on-keys = <
        &kpSPACE &kpTAB &kpENTER &kpESCAPE
        &kpCOMMA &kpDOT &kpSEMI &kpCOLON &kpQUESTION &kpEXCLAMATION
        &kpSLASH &kpBACKSLASH &kpSINGLE_QUOTE &kpDOUBLE_QUOTES &kpGRAVE
        &kpLPAR &kpRPAR &kpLBKT &kpRBKT &kpLBRC &kpRBRC &kpLT &kpGT
        >;
    };
#endif

#ifdef HAS_UROB
    &num_word {
        layers = <NUM_WORD>;
        continue-list = <
        &kpBACKSPACE &kpDELETE &kpDOT &kpCOMMA
        &kpSLASH &kpASTERISK &kpPLUS &kpMINUS &kpEQUAL &kpDOLLAR
        &kpRS &kpSPACE
        >;
        ignore-modifiers;  // modifiers don't deactivate the layer
    };
#endif